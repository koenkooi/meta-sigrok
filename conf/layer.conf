## conf/layer.conf
```bitbake
# We might have a conf and classes directory, append to BBPATH
BBPATH .= ":${LAYERDIR}"

# We have a recipes directory, add to BBFILES
BBFILES += "${LAYERDIR}/recipes*/*/*.bb ${LAYERDIR}/recipes*/*/*.bbappend"

BBFILE_COLLECTIONS += "meta-sigrok"
BBFILE_PATTERN_meta-sigrok := "^${LAYERDIR}/"
BBFILE_PRIORITY_meta-sigrok = "8"
```
